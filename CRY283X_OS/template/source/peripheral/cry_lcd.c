/******************** (C) COPYRIGHT 2023 CRY Sound Co., Ltd ********************
* File Name          : cry_lcd.c
* Author             : Ming
* Mail				 : ming.huang@crysound.com
* Version            : V1.0.0
* Date               : 2023.07.31
* Description        : CRY283x 噪声传感器
*******************************************************************************/
#include "cry_lcd.h"

#include <stdarg.h>

/****************************************** LCD ASCII 字库 *********************************************/



const unsigned char ascii_1206[][12]={

{0x00,0x00,0x00,0x00,0x00,0x00,0x00,0x00,0x00,0x00,0x00,0x00},/*" ",0*/
{0x00,0x00,0x04,0x04,0x04,0x04,0x04,0x00,0x00,0x04,0x00,0x00},/*"!",1*/
{0x14,0x14,0x0A,0x00,0x00,0x00,0x00,0x00,0x00,0x00,0x00,0x00},/*""",2*/
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{0x16,0x09,0x00,0x00,0x00,0x00,0x00,0x00,0x00,0x00,0x00,0x00},/*"~",94*/
};

const unsigned char ascii_1608[][16]={
{0x00,0x00,0x00,0x00,0x00,0x00,0x00,0x00,0x00,0x00,0x00,0x00,0x00,0x00,0x00,0x00},/*" ",0*/
{0x00,0x00,0x00,0x08,0x08,0x08,0x08,0x08,0x08,0x08,0x00,0x00,0x18,0x18,0x00,0x00},/*"!",1*/
{0x00,0x48,0x6C,0x24,0x12,0x00,0x00,0x00,0x00,0x00,0x00,0x00,0x00,0x00,0x00,0x00},/*""",2*/
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{0x0C,0x32,0xC2,0x00,0x00,0x00,0x00,0x00,0x00,0x00,0x00,0x00,0x00,0x00,0x00,0x00},/*"~",94*/
}; 
const unsigned char ascii_2412[][48]={
{0x00,0x00,0x00,0x00,0x00,0x00,0x00,0x00,0x00,0x00,0x00,0x00,0x00,0x00,0x00,0x00,0x00,0x00,0x00,0x00,0x00,0x00,0x00,0x00,0x00,0x00,0x00,0x00,0x00,0x00,0x00,0x00,0x00,0x00,0x00,0x00,0x00,0x00,0x00,0x00,0x00,0x00,0x00,0x00,0x00,0x00,0x00,0x00},/*" ",0*/
{0x00,0x00,0x00,0x00,0x00,0x00,0x00,0x00,0x60,0x00,0x60,0x00,0x60,0x00,0x60,0x00,0x60,0x00,0x60,0x00,0x60,0x00,0x40,0x00,0x20,0x00,0x20,0x00,0x20,0x00,0x00,0x00,0x00,0x00,0x00,0x00,0x60,0x00,0x60,0x00,0x60,0x00,0x00,0x00,0x00,0x00,0x00,0x00},/*"!",1*/
{0x00,0x00,0x00,0x00,0x60,0x06,0x60,0x06,0x30,0x03,0x98,0x01,0x88,0x00,0x44,0x00,0x00,0x00,0x00,0x00,0x00,0x00,0x00,0x00,0x00,0x00,0x00,0x00,0x00,0x00,0x00,0x00,0x00,0x00,0x00,0x00,0x00,0x00,0x00,0x00,0x00,0x00,0x00,0x00,0x00,0x00,0x00,0x00},/*""",2*/
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{0x00,0x00,0x1C,0x00,0x22,0x04,0xC2,0x04,0x80,0x03,0x00,0x00,0x00,0x00,0x00,0x00,0x00,0x00,0x00,0x00,0x00,0x00,0x00,0x00,0x00,0x00,0x00,0x00,0x00,0x00,0x00,0x00,0x00,0x00,0x00,0x00,0x00,0x00,0x00,0x00,0x00,0x00,0x00,0x00,0x00,0x00,0x00,0x00},/*"~",94*/


};
const unsigned char ascii_3216[][64]={
{0x00,0x00,0x00,0x00,0x00,0x00,0x00,0x00,0x00,0x00,0x00,0x00,0x00,0x00,0x00,0x00,0x00,0x00,0x00,0x00,0x00,0x00,0x00,0x00,0x00,0x00,0x00,0x00,0x00,0x00,0x00,0x00,0x00,0x00,0x00,0x00,0x00,0x00,0x00,0x00,0x00,0x00,0x00,0x00,0x00,0x00,0x00,0x00,0x00,0x00,0x00,0x00,0x00,0x00,0x00,0x00,0x00,0x00,0x00,0x00,0x00,0x00,0x00,0x00},/*" ",0*/
{0x00,0x00,0x00,0x00,0x00,0x00,0x00,0x00,0x00,0x00,0xC0,0x01,0xC0,0x01,0xC0,0x01,0xC0,0x01,0xC0,0x01,0xC0,0x01,0xC0,0x01,0x80,0x00,0x80,0x00,0x80,0x00,0x80,0x00,0x80,0x00,0x80,0x00,0x80,0x00,0x00,0x00,0x00,0x00,0x00,0x00,0x00,0x00,0x80,0x01,0xC0,0x03,0xC0,0x03,0x80,0x01,0x00,0x00,0x00,0x00,0x00,0x00,0x00,0x00,0x00,0x00},/*"!",1*/
{0x00,0x00,0x00,0x00,0x00,0x00,0xE0,0x1C,0xE0,0x1C,0xF0,0x1E,0x70,0x0E,0x38,0x07,0x18,0x03,0x08,0x01,0x84,0x00,0x00,0x00,0x00,0x00,0x00,0x00,0x00,0x00,0x00,0x00,0x00,0x00,0x00,0x00,0x00,0x00,0x00,0x00,0x00,0x00,0x00,0x00,0x00,0x00,0x00,0x00,0x00,0x00,0x00,0x00,0x00,0x00,0x00,0x00,0x00,0x00,0x00,0x00,0x00,0x00,0x00,0x00},/*""",2*/
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{0x00,0x00,0x38,0x00,0xC4,0x00,0x86,0x40,0x02,0x61,0x00,0x22,0x00,0x1C,0x00,0x00,0x00,0x00,0x00,0x00,0x00,0x00,0x00,0x00,0x00,0x00,0x00,0x00,0x00,0x00,0x00,0x00,0x00,0x00,0x00,0x00,0x00,0x00,0x00,0x00,0x00,0x00,0x00,0x00,0x00,0x00,0x00,0x00,0x00,0x00,0x00,0x00,0x00,0x00,0x00,0x00,0x00,0x00,0x00,0x00,0x00,0x00,0x00,0x00},/*"~",94*/
};


/****************************************** 硬件初始化 *********************************************/
#ifdef USE_RT_THREAD
#include "rtthread.h"
static struct rt_semaphore spi1_tx_wait = {0x00};
#endif

uint32_t mypow(uint8_t m,uint8_t n)
{
	uint32_t result=1;	 
	while(n--)result*=m;
	return result;
}

void lcd_spi_tx_dma_tc0_irq_cb(void)
{
    DMA_ClearIrqFlag(LCD_SPI_DMA_UNIT, LCD_SPI_DMA_TX_CHANNEL, TrnCpltIrq);
#ifdef USE_RT_THREAD
	rt_sem_release(&spi1_tx_wait);
#endif
	printf("111\r\r");
}

void lac_spi_dma_config(void)
{
    stc_dma_config_t stcDmaCfg;
    stc_irq_regi_conf_t stcIrqRegiConf;

    MEM_ZERO_STRUCT(stcDmaCfg);
	MEM_ZERO_STRUCT(stcIrqRegiConf);

    PWC_Fcg0PeriphClockCmd(LCD_SPI_DMA_CLOCK_UNIT, Enable);
    PWC_Fcg0PeriphClockCmd(PWC_FCG0_PERIPH_AOS, Enable);
    
    stcDmaCfg.u16BlockSize           = 1;
    stcDmaCfg.u16TransferCnt         = 1;
    stcDmaCfg.u32SrcAddr             = (uint32_t)(0);
    stcDmaCfg.u32DesAddr             = (uint32_t)(&LCD_SPI_UNIT->DR);
    stcDmaCfg.stcDmaChCfg.enSrcInc   = AddressIncrease;
    stcDmaCfg.stcDmaChCfg.enDesInc   = AddressFix;
    stcDmaCfg.stcDmaChCfg.enTrnWidth = Dma8Bit;
    stcDmaCfg.stcDmaChCfg.enIntEn    = Enable;
    DMA_InitChannel(LCD_SPI_DMA_UNIT, LCD_SPI_DMA_TX_CHANNEL, &stcDmaCfg);
    DMA_SetTriggerSrc(LCD_SPI_DMA_UNIT, LCD_SPI_DMA_TX_CHANNEL, LCD_SPI_DMA_TX_TRIG_SOURCE);


    DMA_Cmd(LCD_SPI_DMA_UNIT, Enable);

    stcIrqRegiConf.enIRQn      = Int008_IRQn;
    stcIrqRegiConf.pfnCallback = &lcd_spi_tx_dma_tc0_irq_cb;
    stcIrqRegiConf.enIntSrc    = INT_DMA1_TC0;
    enIrqRegistration(&stcIrqRegiConf);
    
    NVIC_SetPriority(stcIrqRegiConf.enIRQn, DDL_IRQ_PRIORITY_DEFAULT);
    NVIC_ClearPendingIRQ(stcIrqRegiConf.enIRQn);	
    NVIC_EnableIRQ(stcIrqRegiConf.enIRQn);
}

void lcd_gpio_Init(void)
{
	stc_port_init_t stcPortInit;

    MEM_ZERO_STRUCT(stcPortInit);

    stcPortInit.enPinMode = Pin_Mode_Out;

	LCD_RES_Clr();
    PORT_Init(LCD_RES_PORT, LCD_RES_PIN, &stcPortInit);

	LCD_DC_Clr();
    PORT_Init(LCD_DC_PORT, LCD_DC_PIN, &stcPortInit);

	LCD_NSS_HIGH();
	PORT_Init(LCD_NSS_PORT, LCD_NSS_PIN, &stcPortInit);

	LCD_BLK_Clr();
    PORT_Init(LCD_BLK_PORT, LCD_BLK_PIN, &stcPortInit);
}



void lcd_spi_init(void)
{
	stc_spi_init_t stcSpiInit;
	
	MEM_ZERO_STRUCT(stcSpiInit);
	
	
	PWC_Fcg1PeriphClockCmd(LCD_SPI_UNIT_CLOCK, Enable);
	
	
    PORT_SetFunc(LCD_SPI_SCK_PORT, LCD_SPI_SCK_PIN, LCD_SPI_SCK_FUNC, Disable);
    PORT_SetFunc(LCD_SPI_MOSI_PORT, LCD_SPI_MOSI_PIN, LCD_SPI_MOSI_FUNC, Disable);

    stcSpiInit.enClkDiv                 = SpiClkDiv2;
    stcSpiInit.enFrameNumber            = SpiFrameNumber1;
    stcSpiInit.enDataLength             = SpiDataLengthBit8;
    stcSpiInit.enFirstBitPosition       = SpiFirstBitPositionMSB;
    stcSpiInit.enSckPolarity            = SpiSckIdleLevelLow;
    stcSpiInit.enSckPhase               = SpiSckOddSampleEvenChange;
    stcSpiInit.enReadBufferObject       = SpiReadReceiverBuffer;
    stcSpiInit.enWorkMode               = SpiWorkMode4Line;
    stcSpiInit.enTransMode              = SpiTransOnlySend;
    stcSpiInit.enCommAutoSuspendEn      = Disable;
    stcSpiInit.enModeFaultErrorDetectEn = Disable;
    stcSpiInit.enParitySelfDetectEn     = Disable;
    stcSpiInit.enParityEn               = Disable;
    stcSpiInit.enParity                 = SpiParityEven;

    /* SPI master mode */
    stcSpiInit.enMasterSlaveMode                     = SpiModeMaster;
    stcSpiInit.stcDelayConfig.enSsSetupDelayOption   = SpiSsSetupDelayCustomValue;
    stcSpiInit.stcDelayConfig.enSsSetupDelayTime     = SpiSsSetupDelaySck1;
    stcSpiInit.stcDelayConfig.enSsHoldDelayOption    = SpiSsHoldDelayCustomValue;
    stcSpiInit.stcDelayConfig.enSsHoldDelayTime      = SpiSsHoldDelaySck1;
    stcSpiInit.stcDelayConfig.enSsIntervalTimeOption = SpiSsIntervalCustomValue;
    stcSpiInit.stcDelayConfig.enSsIntervalTime       = SpiSsIntervalSck6PlusPck2;
    stcSpiInit.stcSsConfig.enSsValidBit              = SpiSsValidChannel0;
    stcSpiInit.stcSsConfig.enSs0Polarity             = SpiSsLowValid;
    SPI_Init(LCD_SPI_UNIT, &stcSpiInit);

    SPI_Cmd(LCD_SPI_UNIT, Enable);
	lac_spi_dma_config();
  
#ifdef USE_RT_THREAD
	rt_sem_init(&spi1_tx_wait, "spi3tx", 0, RT_IPC_FLAG_FIFO);	
#endif
}


void lcd_spi_trans(uint8_t *dat, uint16_t len)
{
    DMA_SetSrcAddress (LCD_SPI_DMA_UNIT, LCD_SPI_DMA_TX_CHANNEL, (uint32_t)dat);
    DMA_SetTransferCnt(LCD_SPI_DMA_UNIT, LCD_SPI_DMA_TX_CHANNEL, len);

    LCD_NSS_LOW();
	LCD_DC_Set();
    
    /* Enable DMA channel */
    DMA_ChannelCmd(LCD_SPI_DMA_UNIT, LCD_SPI_DMA_TX_CHANNEL, Enable);
        
    SPI_Cmd(LCD_SPI_UNIT, Enable);
#ifdef USE_RT_THREAD
	rt_sem_take(&spi1_tx_wait, RT_WAITING_FOREVER);
#endif
	while (Reset == DMA_GetIrqFlag(LCD_SPI_DMA_UNIT, LCD_SPI_DMA_TX_CHANNEL, TrnCpltIrq))
    {
		
    }

    
	DMA_ClearIrqFlag(LCD_SPI_DMA_UNIT, LCD_SPI_DMA_TX_CHANNEL, TrnCpltIrq);
    LCD_NSS_HIGH();
    

    SPI_Cmd(LCD_SPI_UNIT, Disable);
    DMA_ChannelCmd(LCD_SPI_DMA_UNIT, LCD_SPI_DMA_TX_CHANNEL, Disable);
}

#define LCDCODE_DATA_LEN            32
#define LCDCODE_REGFLAG_DELAY       0xFFFE
#define LCDCODE_REGFLAG_END         0xFFFF
typedef struct
{
    uint16_t reg;
    uint16_t len;
    uint8_t  dat[LCDCODE_DATA_LEN];
	
}lcd_code_t;
static lcd_code_t st7789v_blockcode[] = {
	{0x2a,  4, {0x00, 0x00, 0x00, 0x00} },
	{0x2b,  4, {0x00, 0x00, 0x00, 0x00} },
	{0x2c,  0, {0x00} },
	{LCDCODE_REGFLAG_END, 0x00, {0x00} }
};


void write_codetable(lcd_code_t *code, uint32_t count)
{
    lcd_code_t *pcode = code;
    
    for (uint32_t i = 0; i < count; i++)
    {   
        if (pcode->reg == LCDCODE_REGFLAG_END)
        {                                   //结束跳出
            break;
        }
        else if (pcode->reg == LCDCODE_REGFLAG_DELAY)
        {                                   //延时MS
            Ddl_Delay1ms(pcode->len);
        }
        else
        {                                   //常规发送指令
            LCD_NSS_LOW();
			LCD_DC_Clr();
            LCD_SPI_Write(pcode->reg);
            for (uint32_t j = 0; j < pcode->len; j++)
            {
                LCD_DC_Set();
                LCD_SPI_Write(pcode->dat[j]);
            }
            LCD_NSS_HIGH();
        }
        pcode++;                            //下一个寄存器   
    }
}

void write_block(uint16_t x0, uint16_t y0, uint16_t x1, uint16_t y1)
{
    st7789v_blockcode[0].dat[0] = 0x00;
    st7789v_blockcode[0].dat[1] = x0;
    st7789v_blockcode[0].dat[2] = 0x00;
    st7789v_blockcode[0].dat[3] = x1;
    st7789v_blockcode[1].dat[0] = y0 >> 8;
    st7789v_blockcode[1].dat[1] = y0 & 0xff;
    st7789v_blockcode[1].dat[2] = y1 >> 8;
    st7789v_blockcode[1].dat[3] = y1 & 0xff;
    write_codetable(st7789v_blockcode, 3);
}

void st7789v_disp_pic(uint8_t *dat, uint16_t x, uint16_t y, uint16_t width, uint16_t height)
{
    uint32_t len, n;
    uint8_t *ptr = dat;
    
    len = width * 2 * height;
    
    write_block(x, y, x + width - 1, y + height - 1);

    while (len > 0)
    {
        n = (len >= 60000)?(60000):(len);
        lcd_spi_trans(ptr, n);
        ptr += n;
        len -= n;
    }
}

void LCD_SPI_Write(uint8_t Data)
{
	while(Reset == SPI_GetFlag(LCD_SPI_UNIT, SpiFlagSendBufferEmpty)){;}  
	SPI_SendData8(LCD_SPI_UNIT, Data);
	while(Reset == SPI_GetFlag(LCD_SPI_UNIT, SpiFlagSpiIdle)){;};
}

void LCD_Write_Bus(uint8_t dat) 
{	
	LCD_SPI_Write(dat);
}

void LCD_WR_DATA8(uint8_t dat)
{
	LCD_NSS_LOW();
	LCD_DC_Set();
	LCD_Write_Bus(dat);
	LCD_NSS_HIGH();
}

void LCD_WR_DATA(uint16_t dat)
{
	LCD_WR_DATA8(dat>>8);
	LCD_WR_DATA8(dat);
}

void LCD_WR_REG(uint8_t dat)
{
	LCD_NSS_LOW();
	LCD_DC_Clr();
	LCD_Write_Bus(dat);
	LCD_NSS_HIGH();
}

void LCD_Address_Set(uint16_t x1,uint16_t y1,uint16_t x2,uint16_t y2)
{
	LCD_WR_REG(0x2a);     //Column address set
	LCD_WR_DATA(x1);    //start column
	LCD_WR_DATA(x2);    //end column

	LCD_WR_REG(0x2b);     //Row address set
	LCD_WR_DATA(y1);    //start row
	LCD_WR_DATA(y2);    //end row
	LCD_WR_REG(0x2C);     //Memory write
}

/****************************************** LCD 显示屏初始化 *********************************************/


void lcd_init(void)
{
	lcd_gpio_Init();
		
	
	LCD_RES_Clr();
	Ddl_Delay1ms(120);
	LCD_RES_Set();
	Ddl_Delay1ms(120);
	
	lcd_spi_init();
	
	
	LCD_WR_REG(0x36);     //行扫描顺序及RGB，列扫描顺序，横放/竖放
	LCD_WR_DATA8(0x00);
	LCD_WR_DATA8(0xA8);
	
	LCD_WR_REG(0xB6);    	//显示功能设置：列/行 显示顺序
	LCD_WR_DATA8(0x0A);    
	LCD_WR_DATA8(0xa2);    	//改变SOURCE线的方向：0xa2：左到右，0x82：右到左
	LCD_WR_REG(0x3A);        //65k mode
	LCD_WR_DATA8(0x05);

	//-------------ST7789V Frame rate setting-----------//
	LCD_WR_REG(0xb2);		//Porch Setting
	LCD_WR_DATA8(0x0C);
	LCD_WR_DATA8(0x0C);
	LCD_WR_DATA8(0x00);
	LCD_WR_DATA8(0x33);
	LCD_WR_DATA8(0x33);

	LCD_WR_REG(0xb7);			//Gate Control
	LCD_WR_DATA8(0x35);			//12.2v   -10.43v
	//--------------ST7789V Power setting---------------//
	LCD_WR_REG(0xBB);//VCOM
	LCD_WR_DATA8(0x28);

	LCD_WR_REG(0xC0); //Power control
	LCD_WR_DATA8(0x2c);

	LCD_WR_REG(0xC2);		//VDV and VRH Command Enable
	LCD_WR_DATA8(0x01);

	LCD_WR_REG(0xC3);			//VRH Set
	LCD_WR_DATA8(0x10);		//4.3+( vcom+vcom offset+vdv)

	LCD_WR_REG(0xC4);			//VDV Set
	LCD_WR_DATA8(0x20);				//0v

	LCD_WR_REG(0xC6);				//Frame Rate Control in Normal Mode
	LCD_WR_DATA8(0X0F);			//111Hz

	LCD_WR_REG(0xd0);				//Power Control 1
	LCD_WR_DATA8(0xa4);
	LCD_WR_DATA8(0xa1);

//	LCD_WR_REG(0xE8);				//Power Control 1
//	LCD_WR_DATA8(0x03);

//	LCD_WR_REG(0xE9);				//Equalize time control
//	LCD_WR_DATA8(0x09);
//	LCD_WR_DATA8(0x09);
//	LCD_WR_DATA8(0x08);
	//---------------ST7789V gamma setting-------------//
	LCD_WR_REG(0xE0); //Set Gamma
	LCD_WR_DATA8(0xd0);
	LCD_WR_DATA8(0x00);
	LCD_WR_DATA8(0x02);
	LCD_WR_DATA8(0x07);
	LCD_WR_DATA8(0x0a);
	LCD_WR_DATA8(0x28);
	LCD_WR_DATA8(0x32);
	LCD_WR_DATA8(0x44);
	LCD_WR_DATA8(0x42);
	LCD_WR_DATA8(0x06);
	LCD_WR_DATA8(0x0e);
	LCD_WR_DATA8(0x12);
	LCD_WR_DATA8(0x14);
	LCD_WR_DATA8(0x17);
		
	LCD_WR_REG(0XE1); //Set Gamma
	LCD_WR_DATA8(0xD0);
	LCD_WR_DATA8(0xd0);
	LCD_WR_DATA8(0x00);
	LCD_WR_DATA8(0x02);
	LCD_WR_DATA8(0x07);
	LCD_WR_DATA8(0x0a);
	LCD_WR_DATA8(0x28);
	LCD_WR_DATA8(0x31);
	LCD_WR_DATA8(0x54);
	LCD_WR_DATA8(0x47);
	LCD_WR_DATA8(0x0e);
	LCD_WR_DATA8(0x1c);
	LCD_WR_DATA8(0x17);
	LCD_WR_DATA8(0x1b);
	LCD_WR_DATA8(0x1e);

//	LCD_WR_REG(0x11); 		//反显
	LCD_WR_REG(0x11); 			//Sleep Out
	Ddl_Delay1ms(10);               //DELAY120ms                                        
	LCD_WR_REG(0x29);         //开启显示
	
}

void LCD_Fill(uint16_t xsta,uint16_t ysta,uint16_t xend,uint16_t yend,uint16_t color)
{          
	uint16_t i,j; 
	LCD_Address_Set(xsta,ysta,xend-1,yend-1);//设置显示范围
	for(i=ysta;i<yend;i++)
	{													   	 	
		for(j=xsta;j<xend;j++)
		{
			LCD_WR_DATA(color);
		}
	} 					  	    
}

void LCD_DrawPoint(uint16_t x,uint16_t y,uint16_t color)
{
	LCD_Address_Set(x,y,x,y);//设置光标位置 
	LCD_WR_DATA(color);
} 

void LCD_DrawLine(uint16_t x1,uint16_t y1,uint16_t x2,uint16_t y2,uint16_t color)
{
	uint16_t t; 
	int xerr=0,yerr=0,delta_x,delta_y,distance;
	int incx,incy,uRow,uCol;
	delta_x=x2-x1; //计算坐标增量 
	delta_y=y2-y1;
	uRow=x1;//画线起点坐标
	uCol=y1;
	if(delta_x>0)incx=1; //设置单步方向 
	else if (delta_x==0)incx=0;//垂直线 
	else {incx=-1;delta_x=-delta_x;}
	if(delta_y>0)incy=1;
	else if (delta_y==0)incy=0;//水平线 
	else {incy=-1;delta_y=-delta_y;}
	if(delta_x>delta_y)distance=delta_x; //选取基本增量坐标轴 
	else distance=delta_y;
	for(t=0;t<distance+1;t++)
	{
		LCD_DrawPoint(uRow,uCol,color);//画点
		xerr+=delta_x;
		yerr+=delta_y;
		if(xerr>distance)
		{
			xerr-=distance;
			uRow+=incx;
		}
		if(yerr>distance)
		{
			yerr-=distance;
			uCol+=incy;
		}
	}
}

void LCD_DrawRectangle(uint16_t x1, uint16_t y1, uint16_t x2, uint16_t y2,uint16_t color)
{
	LCD_DrawLine(x1,y1,x2,y1,color);
	LCD_DrawLine(x1,y1,x1,y2,color);
	LCD_DrawLine(x1,y2,x2,y2,color);
	LCD_DrawLine(x2,y1,x2,y2,color);
}

void LCD_Draw_Circle(uint16_t x0,uint16_t y0,uint8_t r,uint16_t color)
{
	int a,b;
	a=0;b=r;	  
	while(a<=b)
	{
		LCD_DrawPoint(x0-b,y0-a,color);             //3           
		LCD_DrawPoint(x0+b,y0-a,color);             //0           
		LCD_DrawPoint(x0-a,y0+b,color);             //1                
		LCD_DrawPoint(x0-a,y0-b,color);             //2             
		LCD_DrawPoint(x0+b,y0+a,color);             //4               
		LCD_DrawPoint(x0+a,y0-b,color);             //5
		LCD_DrawPoint(x0+a,y0+b,color);             //6 
		LCD_DrawPoint(x0-b,y0+a,color);             //7
		a++;
		if((a*a+b*b)>(r*r))//判断要画的点是否过远
		{
			b--;
		}
	}
}

void LCD_BackLight(bool on_off)
{
	if(on_off)
	{
		LCD_BLK_Set();
	}
	else
	{
		LCD_BLK_Clr();
	}
}

/******************************************************************************
      函数说明：显示单个字符
      入口数据：x,y显示坐标
                num 要显示的字符
                fc 字的颜色
                bc 字的背景色
                sizey 字号
                mode:  0非叠加模式  1叠加模式
      返回值：  无
******************************************************************************/
void LCD_ShowChar(uint16_t x,uint16_t y,uint8_t num,uint16_t fc,uint16_t bc,uint8_t sizey,uint8_t mode)
{
	uint8_t temp,sizex,t,m=0;
	uint16_t i,TypefaceNum;//一个字符所占字节大小
	uint16_t x0=x;
	sizex=sizey/2;
	TypefaceNum=(sizex/8+((sizex%8)?1:0))*sizey;
	num=num-' ';    //得到偏移后的值
	LCD_Address_Set(x,y,x+sizex-1,y+sizey-1);  //设置光标位置 
	for(i=0;i<TypefaceNum;i++)
	{ 
		if(sizey==12)temp=ascii_1206[num][i];		       //调用6x12字体
		else if(sizey==16)temp=ascii_1608[num][i];		 //调用8x16字体
		else if(sizey==24)temp=ascii_2412[num][i];		 //调用12x24字体
		else if(sizey==32)temp=ascii_3216[num][i];		 //调用16x32字体
		else return;
		for(t=0;t<8;t++)
		{
			if(!mode)//非叠加模式
			{
				if(temp&(0x01<<t))LCD_WR_DATA(fc);
				else LCD_WR_DATA(bc);
				m++;
				if(m%sizex==0)
				{
					m=0;
					break;
				}
			}
			else//叠加模式
			{
				if(temp&(0x01<<t))LCD_DrawPoint(x,y,fc);//画一个点
				x++;
				if((x-x0)==sizex)
				{
					x=x0;
					y++;
					break;
				}
			}
		}
	}   	 	  
}


/******************************************************************************
      函数说明：显示字符串
      入口数据：x,y显示坐标
                *p 要显示的字符串
                fc 字的颜色
                bc 字的背景色
                sizey 字号
                mode:  0非叠加模式  1叠加模式
      返回值：  无
******************************************************************************/
void LCD_ShowString(uint16_t x,uint16_t y,const uint8_t *p,uint16_t fc,uint16_t bc,uint8_t sizey,uint8_t mode)
{         
	while(*p!='\0')
	{       
		LCD_ShowChar(x,y,*p,fc,bc,sizey,mode);
		x+=sizey/2;
		p++;
	}  
}

/******************************************************************************
      函数说明：显示整数变量
      入口数据：x,y显示坐标
                num 要显示整数变量
                len 要显示的位数
                fc 字的颜色
                bc 字的背景色
                sizey 字号
      返回值：  无
******************************************************************************/
void LCD_ShowIntNum(uint16_t x,uint16_t y,uint16_t num,uint8_t len,uint16_t fc,uint16_t bc,uint8_t sizey)
{         	
	uint8_t t,temp;
	uint8_t enshow=0;
	uint8_t sizex=sizey/2;
	for(t=0;t<len;t++)
	{
		temp=(num/mypow(10,len-t-1))%10;
		if(enshow==0&&t<(len-1))
		{
			if(temp==0)
			{
				LCD_ShowChar(x+t*sizex,y,' ',fc,bc,sizey,0);
				continue;
			}else enshow=1; 
		 	 
		}
	 	LCD_ShowChar(x+t*sizex,y,temp+48,fc,bc,sizey,0);
	}
} 


/******************************************************************************
      函数说明：显示两位小数变量
      入口数据：x,y显示坐标
                num 要显示小数变量
                len 要显示的位数
                fc 字的颜色
                bc 字的背景色
                sizey 字号
      返回值：  无
******************************************************************************/
void LCD_ShowFloatNum1(uint16_t x,uint16_t y,float num,uint8_t len,uint16_t fc,uint16_t bc,uint8_t sizey)
{         	
	uint8_t t,temp,sizex;
	uint16_t num1;
	sizex=sizey/2;
	num1=num*100;
	for(t=0;t<len;t++)
	{
		temp=(num1/mypow(10,len-t-1))%10;
		if(t==(len-2))
		{
			LCD_ShowChar(x+(len-2)*sizex,y,'.',fc,bc,sizey,0);
			t++;
			len+=1;
		}
	 	LCD_ShowChar(x+t*sizex,y,temp+48,fc,bc,sizey,0);
	}
}

void LCD_Printf(uint16_t x1,uint16_t y1, uint16_t fc,uint16_t bc,uint8_t sizey,uint8_t mode, const char *p, ...)
{
	uint8_t str[256] = {0};
	
	va_list args;
	va_start(args, p);  
	vsprintf((char *)str, p, args);
	va_end(args); 
	
	LCD_ShowString(x1, y1, str, fc, bc, sizey, mode);
}




